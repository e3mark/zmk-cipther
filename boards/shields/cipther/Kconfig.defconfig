## boards/shields/cipther/Kconfig.defconfig
```kconfig
# SPDX-License-Identifier: MIT

if SHIELD_CIPTHER_LEFT

config ZMK_KEYBOARD_NAME
    default "Cipther"

config ZMK_SPLIT_ROLE_CENTRAL
    default y

endif

if SHIELD_CIPTHER_LEFT || SHIELD_CIPTHER_RIGHT

config ZMK_SPLIT
    default y

endif
```

## boards/shields/cipther/Kconfig.shield
```kconfig
# SPDX-License-Identifier: MIT

config SHIELD_CIPTHER_LEFT
    def_bool $(shields_list_contains,cipther_left)

config SHIELD_CIPTHER_RIGHT
    def_bool $(shields_list_contains,cipther_right)
```

## boards/shields/cipther/cipther_left_defconfig
```kconfig
# SPDX-License-Identifier: MIT

CONFIG_ZMK_KEYBOARD_NAME="Cipther Left"
CONFIG_ZMK_SPLIT_ROLE_CENTRAL=y
```
